/* Copyright (c) 2013, The Linux Foundation. All rights reserved.
 *
 * This program is free software; you can redistribute it and/or modify
 * it under the terms of the GNU General Public License version 2 and
 * only version 2 as published by the Free Software Foundation.
 *
 * This program is distributed in the hope that it will be useful,
 * but WITHOUT ANY WARRANTY; without even the implied warranty of
 * MERCHANTABILITY or FITNESS FOR A PARTICULAR PURPOSE.  See the
 * GNU General Public License for more details.
 */

qcom,gbw8901-samsung-2500mah {
	qcom,fcc-mah = <2500>;
	qcom,default-rbatt-mohm = <175>;
	qcom,rbatt-capacitive-mohm = <50>;
	qcom,flat-ocv-threshold-uv = <3700000>;
	qcom,max-voltage-uv = <4350000>;
	qcom,v-cutoff-uv = <3400000>;
	qcom,chg-term-ua = <100000>;
	qcom,batt-id-kohm = <10>;

	qcom,fcc-temp-lut {
		qcom,lut-col-legend = <(-20) 0 25 40 60>;
		qcom,lut-data = <2633 2634 2636 2635 2626>;
	};
	
	qcom,pc-temp-ocv-lut {
		qcom,lut-col-legend = <(-20) 0 25 40 60>;
		qcom,lut-row-legend = <100 95 90 85 80>,
				<75 70 65 60 55>,
				<50 45 40 35 30>,
				<25 20 16 13 11>,
				<10 9 8 7 6>,
				<5 4 3 2 1>,
				<0>;
		qcom,lut-data = <4352 4350 4346 4342 4336>,
				<4226 4270 4280 4278 4274>,
				<4149 4212 4224 4222 4218>,
				<4090 4157 4169 4167 4164>,
				<4037 4103 4117 4115 4111>,
				<3944 4050 4067 4065 4061>,
				<3899 3981 4016 4018 4015>,
				<3857 3926 3966 3974 3973>,
				<3825 3897 3929 3935 3933>,
				<3807 3865 3881 3887 3887>,
				<3791 3836 3847 3848 3847>,
				<3776 3809 3822 3823 3822>,
				<3761 3787 3802 3803 3802>,
				<3745 3771 3786 3786 3786>,
				<3728 3757 3772 3770 3765>,
				<3710 3741 3760 3753 3742>,
				<3687 3724 3742 3734 3719>,
				<3665 3712 3716 3709 3694>,
				<3647 3703 3691 3683 3671>,
				<3629 3696 3688 3681 3669>,
				<3620 3692 3687 3680 3668>,
				<3609 3689 3686 3679 3667>,
				<3597 3684 3685 3678 3666>,
				<3581 3677 3683 3676 3664>,
				<3564 3664 3678 3671 3656>,
				<3543 3643 3660 3651 3625>,
				<3514 3606 3614 3603 3574>,
				<3473 3549 3547 3537 3505>,
				<3410 3461 3453 3444 3411>,
				<3293 3319 3307 3297 3258>,
				<3000 3000 3000 3000 3000>;
	};

	qcom,rbatt-sf-lut {
		qcom,lut-col-legend = <(-20) 0 25 40 60>;
		qcom,lut-row-legend = <100 95 90 85 80>,
				<75 70 65 60 55>,
				<50 45 40 35 30>,
				<25 20 16 13 11>,
				<10 9 8 7 6>,
				<5 4 3 2 1>;

		qcom,lut-data = <684 342 100 79 72>,
				<684 342 100 79 72>,                    
				<684 342 102 81 73>,                    
				<670 335 104 82 74>,                    
				<652 326 108 85 76>,                    
				<648 324 112 87 77>,                    
				<602 301 118 91 79>,                    
				<568 284 124 96 82>,                    
				<578 289 120 100 86>,                    
				<576 288 105 92 82>,                    
				<572 286 99 81 74>,                    
				<568 284 99 81 74>,                    
				<570 285 101 84 77>,                    
				<592 296 104 85 79>,                    
				<626 313 104 85 78>,                    
				<672 336 104 83 76>,                    
				<728 364 104 81 74>,                    
				<772 386 102 82 74>,                    
				<742 371 97 78 73>,                    
				<782 391 98 80 74>,                    
				<804 402 100 82 76>,                    
				<830 415 102 84 77>,                    
				<860 430 105 85 80>,                    
				<890 445 109 88 83>,                    
				<914 457 113 91 84>,                    
				<946 473 113 88 77>,                    
				<974 487 107 85 77>,                    
				<974 517 110 86 80>,                    
				<974 562 121 95 92>,                    
				<1451 1131 786 441 355>;
	};
};
