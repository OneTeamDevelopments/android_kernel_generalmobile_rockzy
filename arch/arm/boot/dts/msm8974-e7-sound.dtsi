/* Copyright (c) 2012-2013, The Linux Foundation. All rights reserved.
 *
 * This program is free software; you can redistribute it and/or modify
 * it under the terms of the GNU General Public License version 2 and
 * only version 2 as published by the Free Software Foundation.
 *
 * This program is distributed in the hope that it will be useful,
 * but WITHOUT ANY WARRANTY; without even the implied warranty of
 * MERCHANTABILITY or FITNESS FOR A PARTICULAR PURPOSE.  See the
 * GNU General Public License for more details.
 */

&soc {
	sound {
		compatible = "qcom,msm8974-audio-taiko";
		qcom,model = "msm8974-taiko-mtp-snd-card";
		qcom,mbhc-gpio-level-insert = <0>;

		qcom,mbhc-disabled = <1>;

		qcom,hdmi-audio-rx;

		qcom,audio-routing =
			"RX_BIAS", "MCLK",
			"LDO_H", "MCLK",
			"AIF4 MAD", "MCLK",
			"AMIC1", "MIC BIAS1 External",
			"MIC BIAS1 External", "Handset Mic",
			"AMIC2", "MIC BIAS2 External",
			"MIC BIAS2 External", "Headset Mic",
			"AMIC3", "MIC BIAS3 External",
			"MIC BIAS3 External", "Handset SubMic",
			"DMIC1", "MIC BIAS1 External",
			"MIC BIAS1 External", "Digital Mic1",
			"DMIC2", "MIC BIAS1 External",
			"MIC BIAS1 External", "Digital Mic2",
			"DMIC3", "MIC BIAS3 External",
			"MIC BIAS3 External", "Digital Mic3",
			"DMIC4", "MIC BIAS3 External",
			"MIC BIAS3 External", "Digital Mic4",
			"DMIC5", "MIC BIAS4 External",
			"MIC BIAS4 External", "Digital Mic5",
			"DMIC6", "MIC BIAS4 External",
			"MIC BIAS4 External", "Digital Mic6";

		qcom,cdc-mclk-gpios = <&pm8941_gpios 15 0>;
		taiko-mclk-clk = <&pm8941_clkdiv1>;
		qcom,taiko-mclk-clk-freq = <9600000>;
	};
};

&slim_msm {
	taiko_codec {
		qcom,cdc-micbias-cfilt2-mv = <2800>;
		qcom,cdc-micbias2-no-ext-cap;
		qcom,cdc-micbias3-cfilt-sel = <0x0>;
		qcom,cdc-micbias4-cfilt-sel = <0x0>;
	};
};
