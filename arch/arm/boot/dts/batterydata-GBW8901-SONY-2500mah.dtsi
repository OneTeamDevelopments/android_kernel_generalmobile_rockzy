/* Copyright (c) 2013, The Linux Foundation. All rights reserved.
 *
 * This program is free software; you can redistribute it and/or modify
 * it under the terms of the GNU General Public License version 2 and
 * only version 2 as published by the Free Software Foundation.
 *
 * This program is distributed in the hope that it will be useful,
 * but WITHOUT ANY WARRANTY; without even the implied warranty of
 * MERCHANTABILITY or FITNESS FOR A PARTICULAR PURPOSE.  See the
 * GNU General Public License for more details.
 */

qcom,gbw8901-sony-2500mah {
	qcom,fcc-mah = <2500>;
	qcom,default-rbatt-mohm = <161>;
	qcom,rbatt-capacitive-mohm = <50>;
	qcom,flat-ocv-threshold-uv = <3700000>;
	qcom,max-voltage-uv = <4350000>;
	qcom,v-cutoff-uv = <3400000>;
	qcom,chg-term-ua = <100000>;
	qcom,batt-id-kohm = <100>;

	qcom,fcc-temp-lut {
		qcom,lut-col-legend = <(-20) 0 25 40 60>;
		qcom,lut-data = <2548 2530 2534 2518 2561>;
	};
	
	qcom,pc-temp-ocv-lut {
		qcom,lut-col-legend = <(-20) 0 25 40 60>;
		qcom,lut-row-legend = <100 95 90 85 80>,
				<75 70 65 60 55>,
				<50 45 40 35 30>,
				<25 20 16 13 11>,
				<10 9 8 7 6>,
				<5 4 3 2 1>,
				<0>;
		qcom,lut-data = <4338 4332 4328 4326 4326>,
				<4227 4249 4254 4255 4255>,
				<4154 4191 4197 4199 4197>,
				<4090 4136 4144 4146 4143>,
				<4032 4080 4093 4095 4092>,
				<3976 4026 4045 4048 4044>,
				<3930 3976 3999 4004 4000>,
				<3887 3933 3952 3962 3958>,
				<3848 3895 3907 3916 3915>,
				<3816 3862 3872 3877 3873>,
				<3789 3834 3844 3848 3843>,
				<3766 3810 3821 3825 3820>,
				<3747 3789 3801 3805 3801>,
				<3730 3772 3784 3788 3783>,
				<3713 3758 3767 3767 3758>,
				<3694 3744 3747 3742 3728>,
				<3675 3726 3728 3722 3707>,
				<3656 3705 3707 3701 3686>,
				<3637 3685 3687 3683 3668>,
				<3622 3673 3677 3674 3661>,
				<3611 3668 3674 3671 3657>,
				<3598 3661 3671 3668 3653>,
				<3583 3654 3665 3663 3646>,
				<3565 3644 3655 3652 3626>,
				<3541 3625 3631 3626 3591>,
				<3509 3591 3590 3586 3547>,
				<3468 3540 3538 3535 3491>,
				<3409 3474 3471 3470 3420>,
				<3327 3386 3379 3383 3325>,
				<3206 3255 3237 3252 3197>,
				<3000 3000 3000 3000 3000>;
	};

	qcom,rbatt-sf-lut {
		qcom,lut-col-legend = <(-20) 0 25 40 60>;
		qcom,lut-row-legend = <100 95 90 85 80>,
				<75 70 65 60 55>,
				<50 45 40 35 30>,
				<25 20 16 13 11>,
				<10 9 8 7 6>,
				<5 4 3 2 1>,
				<0>;
		qcom,lut-data = <890 216 100 79 72>,
				<890 216 100 79 72>,
				<880 221 103 81 72>,
				<872 222 107 83 74>,
				<869 222 111 86 75>,
				<863 217 117 90 77>,
				<871 213 121 94 80>,
				<874 210 116 98 83>,
				<884 213 106 91 81>,
				<907 214 102 83 75>,
				<934 216 103 82 74>,
				<974 221 106 84 75>,
				<1023 225 108 86 77>,
				<1083 231 112 89 78>,
				<1162 238 111 88 77>,
				<1293 247 107 84 75>,
				<1475 253 107 85 76>,
				<1562 253 107 85 76>,
				<1436 251 106 84 75>,
				<1168 239 106 83 76>,
				<1223 243 107 85 77>,
				<1367 249 109 86 78>,
				<1574 258 112 88 80>,
				<1855 269 115 88 78>,
				<2255 279 112 86 78>,
				<2873 286 111 86 79>,
				<3968 303 113 88 81>,
				<6000 345 118 90 85>,
				<10737 427 127 96 98>,
				<22843 708 170 142 316>,
				<53532 5196 10321 2313 5586>;
	};
};
