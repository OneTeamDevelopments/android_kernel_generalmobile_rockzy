/* Copyright (c) 2013, The Linux Foundation. All rights reserved.
 *
 * This program is free software; you can redistribute it and/or modify
 * it under the terms of the GNU General Public License version 2 and
 * only version 2 as published by the Free Software Foundation.
 *
 * This program is distributed in the hope that it will be useful,
 * but WITHOUT ANY WARRANTY; without even the implied warranty of
 * MERCHANTABILITY or FITNESS FOR A PARTICULAR PURPOSE.  See the
 * GNU General Public License for more details.
 */

&mdss_mdp {
	dsi_dual_sharp_video_0: qcom,mdss_dsi_sharp_r63419_wqhd_dualmipi0_video {
		qcom,mdss-dsi-panel-name = "sharp Dual 0 video mode dsi panel";
		qcom,mdss-dsi-panel-controller = <&mdss_dsi0>;
		qcom,mdss-dsi-panel-type = "dsi_video_mode";
		qcom,mdss-dsi-panel-destination = "display_1";
		qcom,mdss-dsi-panel-framerate = <60>;
		qcom,mdss-dsi-virtual-channel-id = <0>;
		qcom,mdss-dsi-stream = <0>;
		qcom,mdss-dsi-panel-width = <720>;
		qcom,mdss-dsi-panel-height = <2560>;
		qcom,mdss-dsi-h-front-porch = <156>;
		qcom,mdss-dsi-h-back-porch = <44>;
		qcom,mdss-dsi-h-pulse-width = <16>;
		qcom,mdss-dsi-h-sync-skew = <0>;
		qcom,mdss-dsi-v-back-porch = <4>;
		qcom,mdss-dsi-v-front-porch = <8>;
		qcom,mdss-dsi-v-pulse-width = <4>;
		qcom,mdss-dsi-h-left-border = <0>;
		qcom,mdss-dsi-h-right-border = <0>;
		qcom,mdss-dsi-v-top-border = <0>;
		qcom,mdss-dsi-v-bottom-border = <0>;
		qcom,mdss-dsi-bpp = <24>;
		qcom,mdss-dsi-color-order = "rgb_swap_rgb";
		qcom,mdss-dsi-bl-pmic-control-type = "bl_ctrl_lm3630";
		qcom,mdss-dsi-underflow-color = <0xff>;
		qcom,mdss-dsi-border-color = <0>;
		qcom,mdss-dsi-h-sync-pulse = <0>;
		qcom,mdss-dsi-traffic-mode = "burst_mode";
		qcom,mdss-dsi-lane-map = "lane_map_0123";
		qcom,mdss-dsi-bllp-eof-power-mode;
		qcom,mdss-dsi-bllp-power-mode;
		qcom,mdss-dsi-lane-0-state;
		qcom,mdss-dsi-lane-1-state;
		qcom,mdss-dsi-lane-2-state;
		qcom,mdss-dsi-lane-3-state;
		qcom,mdss-dsi-panel-timings = [cd 34 24 00 64 68 28 38 2a 03
									04 00];
		qcom,mdss-dsi-reset-sequence = <1 200>, <0 200>, <1 20>;
		qcom,mdss-dsi-t-clk-post = <0x28>;
		qcom,mdss-dsi-t-clk-pre = <0x27>;
		qcom,mdss-dsi-bl-max-level = <255>;
		qcom,mdss-dsi-dma-trigger = "trigger_sw";
		qcom,mdss-dsi-mdp-trigger = "none";
		qcom,mdss-dsi-on-command = [29 01 00 00 00 00 02 b0 00
			29 01 00 00 00 00 02 d6 01
			29 01 00 00 00 00 04 b3 18 00 00
			29 01 00 00 00 00 08 ba b5 32 41 64 23 a0 a0
			29 01 00 00 00 00 14 c8 01 02 ff 00 fe 68 00 02 ff 00 fe b0 00 02 ff 00 fe fc 00
			29 01 00 00 00 00 25 ca 81 e5 80 80 80 80 a0 08 20 80 ff 00 00 00 00 00 00 00 0a 4a 37 a0 55 f8 0c 0c 20 10 3f 3f 10 10 3f 3f 3f 3f
			29 01 00 00 00 00 10 cb e6 e0 c7 63 00 00 00 00 40 00 80 00 e8 00 00
			39 01 00 00 00 00 05 2a 00 00 05 9f
			39 01 00 00 00 00 05 2b 00 00 09 ff
			15 01 00 00 00 00 02 35 00
			15 01 00 00 00 00 02 51 ff
			15 01 00 00 00 00 02 53 24
			15 01 00 00 00 00 02 55 83
			29 01 00 00 00 00 02 b0 03
			05 01 00 00 10 00 02 29 00
			05 01 00 00 78 00 02 11 00];
		qcom,mdss-dsi-on-command-state = "dsi_lp_mode";
		qcom,mdss-dsi-off-command = [05 01 00 00 32 00 02 28 00
					05 01 00 00 78 00 02 10 00];
		qcom,mdss-dsi-off-command-state = "dsi_hs_mode";
	};
};
