/* Copyright (c) 2013, The Linux Foundation. All rights reserved.
 *
 * This program is free software; you can redistribute it and/or modify
 * it under the terms of the GNU General Public License version 2 and
 * only version 2 as published by the Free Software Foundation.
 *
 * This program is distributed in the hope that it will be useful,
 * but WITHOUT ANY WARRANTY; without even the implied warranty of
 * MERCHANTABILITY or FITNESS FOR A PARTICULAR PURPOSE.  See the
 * GNU General Public License for more details.
 */

/*---------------------------------------------------------------------------
 * This file is autogenerated file using gcdb parser. Please do not edit it.
 * Update input XML file to add a new entry or update variable in this file
 * VERSION = "1.0"
 *---------------------------------------------------------------------------*/
&mdss_mdp {
	dsi_truly_r63417_1080_cmd: qcom,mdss_dsi_truly_r63417_1080p_cmd {
		qcom,mdss-dsi-panel-name = "truly r63417 1080p command mode dsi panel";
		qcom,mdss-dsi-panel-controller = <&mdss_dsi0>;
		qcom,mdss-dsi-panel-type = "dsi_cmd_mode";
		qcom,mdss-dsi-panel-destination = "display_1";
		qcom,mdss-dsi-panel-framerate = <60>;
		qcom,mdss-dsi-virtual-channel-id = <0>;
		qcom,mdss-dsi-stream = <0>;
		qcom,mdss-dsi-panel-width = <1080>;
		qcom,mdss-dsi-panel-height = <1920>;
		qcom,mdss-dsi-h-front-porch = <52>;
		qcom,mdss-dsi-h-back-porch = <52>;
		qcom,mdss-dsi-h-pulse-width = <12>;
		qcom,mdss-dsi-h-sync-skew = <0>;
		qcom,mdss-dsi-v-back-porch = <20>;
		qcom,mdss-dsi-v-front-porch = <20>;
		qcom,mdss-dsi-v-pulse-width = <10>;
		qcom,mdss-dsi-h-left-border = <0>;
		qcom,mdss-dsi-h-right-border = <0>;
		qcom,mdss-dsi-v-top-border = <0>;
		qcom,mdss-dsi-v-bottom-border = <0>;
		qcom,mdss-dsi-bpp = <24>;
		qcom,mdss-dsi-color-order = <0>;
		qcom,mdss-dsi-underflow-color = <0xff>;
		qcom,mdss-dsi-border-color = <0>;
		qcom,mdss-dsi-on-command = [
					15 01 00 00 00 00 02 
						35 00
					23 01 00 00 00 00 02 
						B0 04
					23 01 00 00 00 00 02 
						d6 01
					29 01 00 00 00 00 07 
						B3 04 00 00 00 00 00
					29 01 00 00 00 00 03
						B6 3A D3
					29 01 00 00 00 00 07
						b8 07 90 1e 10 1e 32 
					29 01 00 00 00 00 07
						b9 07 82 3c 10 3c 87
					29 01 00 00 00 00 07
						ba 07 78 64 10 64 b4
					23 01 00 00 00 00 02
						C0 00 
					29 01 00 00 00 00 23 			
						C1 84 60 10 EB FF 6F CE FF FF 17 12 58 73
						AE 31 20 C6 FF FF 1F F3 FF 5F 10 10 10 10 
						00 62 01 22 22 00 01
					29 01 00 00 00 00 08 
						C2 31 f7 80 08 08 00 00
					29 01 00 00 00 00 17 
						C4 70 00 00 00 00 04 00 00 00
						0C 06 00 00 00 00 00 04 00 00 00 0C 06
					29 01 00 00 00 00 29 
						C6 70 08 67 08 67 00 00 00 00 00 00 00 00 
						00 00 00 00 16 18 08 70 08 67 08 67 00 00 
						00 00 00 00 00 00 00 00 00 00 16 18 08
					29 01 00 00 00 00 0A
						CB 31 FC 3F 8C 00 00 00 00 C0
					23 01 00 00 00 00 02 
						CC 0B
					29 01 00 00 00 00 0B
						D0 11 81 BB 1E 1E 4C 19 19 0C 00
					29 01 00 00 00 00 1A
						D3 1B 33 BB BB B3 33 33 33 00 01 00 A0 D8 
						A0 0D 4e 4e 44 3B 22 72 07 3D BF 11
					29 01 00 00 00 00 08 
						D5 06 00 00 01 48 01 32
					29 01 00 00 00 00 03 
						DD 31 93
					29 01 00 00 00 00 1F 
						c7 01 0f 1b 23 32 3e 47 52 35 3f 4d 5d 64 6c 76
						   01 0f 1b 23 32 3e 47 52 35 3f 4d 5d 64 6c 76
					29 01 00 00 00 00 14 
						C8 01 00 10 f8 00 c0 00 00 00 00 00 e8 00 00 00 00 00 fc 00
					29 01 00 00 00 00 21 
						ca 01 80 90 ff ff ff ff ff 0b 32 80 a0 0a 4a 37 a0 55 f8 0c 
						0c 20 10 3f 3f f0 00 10 10 3f 3f 3f 3f 	
					15 01 00 00 00 00 02 
						51 FF
					15 01 00 00 00 00 02 
						53 24
					15 01 00 00 00 00 02 
						55 03
					05 01 00 00 78 00 02 
						11 00   /*78 = 120ms for r63417*/
					05 01 00 00 14 00 02 
						29 00
    ];  

		qcom,mdss-dsi-off-command = [
					29 01 00 00 00 00 08
                                                 d5 06 00 00 00 48 00 48
                                        29 01 00 00 14 00 08
                                                 d5 06 00 00 00 48 00 48
                                        05 01 00 00 78 00 02
                                                 28 00
                                        05 01 00 00 78 00 02
                                                 10 00

					];
		qcom,mdss-dsi-on-command-state = "dsi_lp_mode";
		qcom,mdss-dsi-off-command-state = "dsi_hs_mode";
		qcom,mdss-dsi-h-sync-pulse = <1>;
		qcom,mdss-dsi-traffic-mode = "burst_mode";
		qcom,mdss-dsi-lane-map = <0>;
		qcom,mdss-dsi-bllp-eof-power-mode;
		qcom,mdss-dsi-bllp-power-mode;
		qcom,mdss-dsi-lane-0-state;
		qcom,mdss-dsi-lane-1-state;
		qcom,mdss-dsi-lane-2-state;
		qcom,mdss-dsi-lane-3-state;
		qcom,mdss-dsi-te-pin-select = <1>;
		qcom,mdss-dsi-te-v-sync-rd-ptr-irq-line = <0x2c>;
		qcom,mdss-dsi-te-dcs-command = <1>;
		qcom,mdss-dsi-te-check-enable;
		qcom,mdss-dsi-te-using-te-pin;
		qcom,mdss-dsi-panel-timings = [dd 48 3c 00 61 59 3b 4a 5f 03 04 00];
		qcom,mdss-dsi-t-clk-post = <0x1e>;
		qcom,mdss-dsi-t-clk-pre = <0x38>;
		qcom,mdss-dsi-bl-min-level = <1>;
		qcom,mdss-dsi-bl-max-level = <255>;
		qcom,mdss-dsi-dma-trigger = "trigger_sw";
		qcom,mdss-dsi-mdp-trigger = "none";
		qcom,mdss-dsi-bl-pmic-control-type = "bl_ctrl_lm3630";
		qcom,mdss-dsi-reset-sequence = <1 20>, <0 1>, <1 20>;
		qcom,mdss-pan-physical-width-dimension = <59>;
		qcom,mdss-pan-physical-height-dimension = <104>;

		/* kernel configure the lcd id gpio, do nothing, 20131225*/
		qcom,gn_lcd_adc0_gpio = <&msmgpio 81 0>;
		qcom,gn_lcd_adc1_gpio = <&msmgpio 82 0>;
	};
};
