## drivers/misc/gn/Kconfig
```kconfig
menu "Gionee specific support"

config GN_Q_BSP_CHARGE_VOLTAGE_SUPPORT
	bool "GN_Q_BSP_CHARGE_VOLTAGE_SUPPORT"
	default y

config GN_Q_BSP_CPU_WR_HOTPLUG_DISABLED_SUPPORT
	bool "GN_Q_BSP_CPU_WR_HOTPLUG_DISABLED_SUPPORT"
	default y

config GN_Q_BSP_AUDIO_HEADSET_SUPPORT
	bool "GN_Q_BSP_AUDIO_HEADSET_SUPPORT"
	default y

config GN_CAMERA_24M_MCLOCK_SUPPORT
	bool "GN_CAMERA_24M_MCLOCK_SUPPORT"
	default y

config GN_CAMERA_SUPPORT
	bool "GN_CAMERA_SUPPORT"
	default y

config GN_Q_BSP_LCD_TE_ANALOG_SUPPORT
	bool "GN_Q_BSP_LCD_TE_ANALOG_SUPPORT"
	default y

config GN_Q_BSP_BACKLIGHT_LM3630_SUPPORT
	bool "GN_Q_BSP_BACKLIGHT_LM3630_SUPPORT"
	default y


config GN_Q_BSP_LCD_TPS65132_SUPPORT
	bool "GN_Q_BSP_LCD_TPS65132_SUPPORT"
	default y

config GN_Q_BSP_LCD_RESET_SUPPORT
	bool "GN_Q_BSP_LCD_RESET_SUPPORT"
	default y

config GN_Q_BSP_LCD_COMPATIBILITY_SUPPORT
	bool "GN_Q_BSP_LCD_COMPATIBILITY_SUPPORT"
	default y

config GN_Q_BSP_PMIC_DISABLE_LOW_TM_INTERRUPTS_SUPPORT
	bool "GN_Q_BSP_PMIC_DISABLE_LOW_TM_INTERRUPTS_SUPPORT"
	default y

config GN_Q_BSP_BATTERY_10K_NTC_SUPPORT
	bool "GN_Q_BSP_BATTERY_10K_NTC_SUPPORT"
	default y

config GN_SUNNY_OV16825
	bool "GN_SUNNY_OV16825"
	default y

config GN_SUNNY_OV4688
	bool "GN_SUNNY_OV4688"
	default y

config GN_Q_BSP_PM_NON_STANDARD_CHARGER_SUPPORT
	bool "GN_Q_BSP_PM_NON_STANDARD_CHARGER_SUPPORT"
	default y

config GN_Q_BSP_SUPPORT
	bool "GN_Q_BSP_SUPPORT"
	default y

config GN_Q_BSP_ISA1200_QPNPCLK_SUPPORT
	bool "GN_Q_BSP_ISA1200_QPNPCLK_SUPPORT"
	default y

config GN_Q_BSP_ISA1200_LEVEL_SUPPORT
	bool "GN_Q_BSP_ISA1200_LEVEL_SUPPORT"
	default y

config GN_Q_BSP_OPTIMIZE_SOC_SUPPORT
	bool "GN_Q_BSP_OPTIMIZE_SOC_SUPPORT"
	default y

config GN_Q_BSP_BTC_SUPPORT
	bool "GN_Q_BSP_BTC_SUPPORT"
	default y

config GN_Q_BSP_OVP_9P5V_SUPPORT
	bool "GN_Q_BSP_OVP_9P5V_SUPPORT"
	default y

config GN_Q_BSP_PM8941_CHARGER_SUPPORT
	bool "GN_Q_BSP_PM8941_CHARGER_SUPPORT"
	default y

config GN_Q_BSP_PM_CHG_DEBUG_SUPPORT
	bool "GN_Q_BSP_PM_CHG_DEBUG_SUPPORT"
	default y

config GN_Q_BSP_LK_DISABLE_EMMC_HS400
	bool "GN_Q_BSP_LK_DISABLE_EMMC_HS400"
	default y

config GN_Q_BSP_ENFORCE_EMMC_TIMEOUT_SUPPORT
	bool "GN_Q_BSP_ENFORCE_EMMC_TIMEOUT_SUPPORT"
	default y

config GN_Q_BSP_DEVICE_TYPE_CHECK_SUPPORT
	bool "GN_Q_BSP_DEVICE_TYPE_CHECK_SUPPORT"
	default y

config GN_SCALADO_FEATURE_SUPPORT
	bool "GN_SCALADO_FEATURE_SUPPORT"
	default y
	
config GN_ARCSOFT_FEATURE_SUPPORT
	bool "GN_ARCSOFT_FEATURE_SUPPORT"
	default y
	
config GN_CRUNCHFISH_FEATURE_SUPPORT
	bool "GN_CRUNCHFISH_FEATURE_SUPPORT"
	default y
	
config GN_SCALADO_LIVE_EFFECT_SUPPORT
	bool "GN_SCALADO_LIVE_EFFECT_SUPPORT"
	default y
	
config GN_SCALADO_PICTURE_FRAME_SUPPORT
	bool "GN_SCALADO_PICTURE_FRAME_SUPPORT"
	default y
	
config GN_SCALADO_HDR_SUPPORT
	bool "GN_SCALADO_HDR_SUPPORT"
	default y
	
config GN_SCALADO_LOWLIGHT_SUPPORT
	bool "GN_SCALADO_LOWLIGHT_SUPPORT"
	default y
	
config GN_SCALADO_MIRROR_SUPPORT
	bool "GN_SCALADO_MIRROR_SUPPORT"
	default y
	
config GN_ARCSOFT_GESTURE_SHOT_SUPPORT
	bool "GN_ARCSOFT_GESTURE_SHOT_SUPPORT"
	default y
	
config GN_CRUNCHFISH_GESTURE_DETECTION_SUPPORT
	bool "GN_CRUNCHFISH_GESTURE_DETECTION_SUPPORT"
	default y
	
	config GN_ARCSOFT_FACE_BEAUTY_SUPPORT
	bool "GN_ARCSOFT_FACE_BEAUTY_SUPPORT"
	default y
	
config GN_ARCSOFT_AGEGENDER_DETECTION_SUPPORT
	bool "GN_ARCSOFT_AGEGENDER_DETECTION_SUPPORT"
	default y
	
config GN_ARCSOFT_SCENE_DETECTION_SUPPORT
	bool "GN_ARCSOFT_SCENE_DETECTION_SUPPORT"
	default y
	
config GN_ARCSOFT_NIGHT_SHOT_SUPPORT
	bool "GN_ARCSOFT_NIGHT_SHOT_SUPPORT"
	default y
	
config GN_SCALADO_AUTORAMA_SUPPORT
	bool "GN_SCALADO_AUTORAMA_SUPPORT"
	default y
	
config GN_ARCSOFT_LIVE_EFFECT_SUPPORT
	bool "GN_ARCSOFT_LIVE_EFFECT_SUPPORT"
	default y
	
config GN_ARCSOFT_PIC_ZOOM_SUPPORT
	bool "GN_ARCSOFT_PIC_ZOOM_SUPPORT"
	default y

config GN_CAMERA_FEATURE_SUPPORT
	bool "GN_CAMERA_FEATURE_SUPPORT"
	default y

endmenu
```
